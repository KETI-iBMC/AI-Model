## zephyr/build/Kconfig/Kconfig.modules
```kconfig
menu "hal_nordic (/root/zephyrproject/modules/hal/nordic)"
osource "$(ZEPHYR_HAL_NORDIC_KCONFIG)"
config ZEPHYR_HAL_NORDIC_MODULE
	bool
	default y
endmenu
menu "mbedtls (/root/zephyrproject/modules/crypto/mbedtls)"
osource "$(ZEPHYR_MBEDTLS_KCONFIG)"
config ZEPHYR_MBEDTLS_MODULE
	bool
	default y
endmenu
menu "sof (/root/zephyrproject/modules/audio/sof)"
osource "/root/zephyrproject/modules/audio/sof/zephyr/Kconfig"
config ZEPHYR_SOF_MODULE
	bool
	default y
endmenu
menu "TraceRecorder (/root/zephyrproject/modules/debug/TraceRecorder)"
osource "/root/zephyrproject/modules/debug/TraceRecorder/kernelports/Zephyr/Kconfig"
config ZEPHYR_TRACERECORDER_MODULE
	bool
	default y
endmenu
menu "trusted-firmware-m (/root/zephyrproject/modules/tee/tfm)"
osource "$(ZEPHYR_TRUSTED_FIRMWARE_M_KCONFIG)"
config ZEPHYR_TRUSTED_FIRMWARE_M_MODULE
	bool
	default y
endmenu
menu "nanopb (/root/zephyrproject/modules/lib/nanopb)"
osource "$(ZEPHYR_NANOPB_KCONFIG)"
config ZEPHYR_NANOPB_MODULE
	bool
	default y
endmenu
menu "tensorflow (/root/zephyrproject/modules/lib/tensorflow)"
osource "$(ZEPHYR_TENSORFLOW_KCONFIG)"
config ZEPHYR_TENSORFLOW_MODULE
	bool
	default y
endmenu
```

## zephyr/build/Kconfig/Kconfig.soc.arch
```kconfig
osource "/root/zephyrproject/zephyr/soc/$(ARCH)/Kconfig"
osource "/root/zephyrproject/zephyr/soc/$(ARCH)/*/Kconfig"
```
